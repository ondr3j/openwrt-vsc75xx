## target/linux/vsc75xx/files/arch/arm/mach-grocx/Kconfig
```kconfig
if ARCH_GROCX

menu "GROCX Options"

config CONSOLE_BAUD_RATE
	int "Console Baud Rate"
	default 115200
	help
	  set the console baudrate

config VIC_INTERRUPT
	bool "Enable Vector Interrupt Controller"
	default y
	help
	  enable the vector interrupt controller

choice
	prompt "Consistent DMA SIZE"
	default GROCX_CONSISTENT_DMA_2M

config GROCX_CONSISTENT_DMA_2M
	bool "2MBytes"

config GROCX_CONSISTENT_DMA_4M
	bool "4MBytes"

config GROCX_CONSISTENT_DMA_8M
	bool "8MBytes"

config GROCX_CONSISTENT_DMA_12M
	bool "12MBytes"

config GROCX_CONSISTENT_DMA_16M
	bool "16MBytes"

endchoice

if PCI
choice
	prompt "PCI Frequency"
	default GROCX_PCI33M

config GROCX_PCI33M
	bool "PCI_33MHz"

config GROCX_PCI66M
	bool "PCI_66MHz"

endchoice
endif

config GROCX_DMA
	bool "DMA Controller Driver"
	default n
	help
	  enable the DMA controller driver

config GROCX_HSDMA
	bool "HSDMA Controller Driver"
	default n
	help
	  enable the HSDMA controller driver

config GROCX_INFO
	bool "GROCX Infomation at /proc/grocx/info"

comment "Third Party Support"

config GROCX_EWC_SUPPORT
	bool "EWC(PreN) Support"

endmenu

endif
```

## target/linux/vsc75xx/files/drivers/net/grocx_shnat/Kconfig
```kconfig
menu "STAR SHNAT support"
	depends on ARM && ARCH_GROCX

config STAR_SHNAT
	bool "STAR Smart HNAT Support"
	depends on ARM && ARCH_GROCX
	help
	  Add STAR Smart HNAT support function in kernel
config STAR_SHNAT_UDP_SESSION_BY_PACKET_COUNT
	bool " UDP Session by packet count"
	depends on NF_CT_ACCT && STAR_SHNAT
	help
	  Add HNAT UDP session by packet count. This is for UDP stream which might only contain traffic flow of one direction might also have chance to be accerated by HNAT

config STAR_SHNAT_UDP_PACKET_COUNT_THRESH
	int " Threshold of packet count "
	depends on STAR_SHNAT_UDP_SESSION_BY_PACKET_COUNT
	default 3
	help 
	  Threshold of packet count for UDP Session to be created

config STAR_SHNAT_PACKET_SKIP_COUNT
	int " Threshold of packet count to create TCP/UDP session"
	default 16
	help 
	  Threshold of packet count for TCP/UDP Session to be created

endmenu
```

## target/linux/vsc75xx/image/Config.in
```kconfig
config WEBROCX_RELEASE
	string "The WebRocX Build Release Name"
	default "Development Build"

config VSC75XX_UBOOT
	bool "Build u-boot loader"
	depends @TARGET_vsc75xx
	default y

config UBOOT_TARGET
	string "U-Boot Board Configuration"
	depends VSC75XX_UBOOT
	default "grocx_scutum"
	help
	  For all supported boards there are ready-to-use default
		configurations available; just type "<board_name>".

config VIGOR_MODEL
	string "Model Name for Building"
	default "2130"
```
